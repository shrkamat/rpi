## build/pi2/conf/bblayers.conf
```bitbake
# POKY_BBLAYERS_CONF_VERSION is increased each time build/conf/bblayers.conf
# changes incompatibly
POKY_BBLAYERS_CONF_VERSION = "2"

BBPATH = "${TOPDIR}"
BBFILES ?= ""

BBLAYERS ?= " \
  /home/shrkamat/.gvm/pkgsets/go1.11/global/src/rpi/layers/poky/meta \
  /home/shrkamat/.gvm/pkgsets/go1.11/global/src/rpi/layers/poky/meta-poky \
  /home/shrkamat/.gvm/pkgsets/go1.11/global/src/rpi/layers/poky/meta-yocto-bsp \
  "
```
